## base_external/package/ldd/Config.in
```kconfig
config BR2_PACKAGE_LDD
	bool "ldd"
	help
	  Includes ldd modules or assignment 7
	  Used to understand buildroot external trees and package builds.
```
